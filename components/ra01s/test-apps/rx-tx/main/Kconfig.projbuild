## components/ra01s/test-apps/rx-tx/main/Kconfig.projbuild
```kconfig
menu "Sx126x RX/TX test config"

	choice DIRECTION
		prompt "Communication polarity"
		default SENDER
		help
			Select Communication polarity.
		config SENDER
			bool "As the sender"
			help
				As the sender.
		config RECEIVER
			bool "As the receiver"
			help
				As the receiver.
	endchoice

endmenu 
```
